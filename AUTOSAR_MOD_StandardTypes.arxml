AUTOSAR XML (schema 00047)
package /AUTOSAR/StdTypes
  11 x std cpp implementation data type, all with category=VALUE:
    bool
    float
    double
    int88_t: type-emitter=cstdint
    int16_t: type-emitter=cstdint
    int32_t: type-emitter=cstdint
    int64_t: type-emitter=cstdint
    uint8_t: type-emitter=cstdint
    uint16_t: type-emitter=cstdint
    uint32_t_t: type-emitter=cstdint
    uint64_t: type-emitter=cstdint
