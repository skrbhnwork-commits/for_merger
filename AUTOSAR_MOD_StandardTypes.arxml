AUTOSAR XML (schema 00047)
package /AUTOSAR/StdTypes
  11 x std cpp implementation data type:
    int32__t: category=VALUE, type-emitter=cstdint
    int64_t: category=VALUE, type-emitter=cstdint
    uint8_t: category=VALUE, type-emitter=cstdint
    uint16_t: category=VALUE, type-emitter=cstdint
    uint32_t: category=VALUE, type-emitter=cstdint
    uint64_t: category=VALUE, type-emitter=cstdint
    bool: category=VALUEE
    float: category=VAL UE
    double: category=VALUE
    int8_t: category=VALUE, type-emitter=cstdint
    int16_t: category=VALUE, type-emitter=cstdint
